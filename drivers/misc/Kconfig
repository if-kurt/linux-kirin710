## drivers/misc/Kconfig
```kconfig
# SPDX-License-Identifier: GPL-2.0-only
#
# Misc strange devices
#

menu "Misc devices"

config SENSORS_LIS3LV02D
	tristate
	depends on INPUT

config AD525X_DPOT
	tristate "Analog Devices Digital Potentiometers"
	depends on (I2C || SPI) && SYSFS
	help
	  If you say yes here, you get support for the Analog Devices
	  AD5258, AD5259, AD5251, AD5252, AD5253, AD5254, AD5255
	  AD5160, AD5161, AD5162, AD5165, AD5200, AD5201, AD5203,
	  AD5204, AD5206, AD5207, AD5231, AD5232, AD5233, AD5235,
	  AD5260, AD5262, AD5263, AD5290, AD5291, AD5292, AD5293,
	  AD7376, AD8400, AD8402, AD8403, ADN2850, AD5241, AD5242,
	  AD5243, AD5245, AD5246, AD5247, AD5248, AD5280, AD5282,
	  ADN2860, AD5273, AD5171, AD5170, AD5172, AD5173, AD5270,
	  AD5271, AD5272, AD5274
	  digital potentiometer chips.

	  See Documentation/misc-devices/ad525x_dpot.rst for the
	  userspace interface.

	  This driver can also be built as a module.  If so, the module
	  will be called ad525x_dpot.

config AD525X_DPOT_I2C
	tristate "support I2C bus connection"
	depends on AD525X_DPOT && I2C
	help
	  Say Y here if you have a digital potentiometers hooked to an I2C bus.

	  To compile this driver as a module, choose M here: the
	  module will be called ad525x_dpot-i2c.

config AD525X_DPOT_SPI
	tristate "support SPI bus connection"
	depends on AD525X_DPOT && SPI_MASTER
	help
	  Say Y here if you have a digital potentiometers hooked to an SPI bus.

	  If unsure, say N (but it's safe to say "Y").

	  To compile this driver as a module, choose M here: the
	  module will be called ad525x_dpot-spi.

config DUMMY_IRQ
	tristate "Dummy IRQ handler"
	help
	  This module accepts a single 'irq' parameter, which it should register for.
	  The sole purpose of this module is to help with debugging of systems on
	  which spurious IRQs would happen on disabled IRQ vector.

config IBM_ASM
	tristate "Device driver for IBM RSA service processor"
	depends on X86 && PCI && INPUT
	depends on SERIAL_8250 || SERIAL_8250=n
	help
	  This option enables device driver support for in-band access to the
	  IBM RSA (Condor) service processor in eServer xSeries systems.
	  The ibmasm device driver allows user space application to access
	  ASM (Advanced Systems Management) functions on the service
	  processor. The driver is meant to be used in conjunction with
	  a user space API.
	  The ibmasm driver also enables the OS to use the UART on the
	  service processor board as a regular serial port. To make use of
	  this feature serial driver support (CONFIG_SERIAL_8250) must be
	  enabled.

	  WARNING: This software may not be supported or function
	  correctly on your IBM server. Please consult the IBM ServerProven
	  website <https://www-03.ibm.com/systems/info/x86servers/serverproven/compat/us/>
	  for information on the specific driver level and support statement
	  for your IBM server.

config IBMVMC
	tristate "IBM Virtual Management Channel support"
	depends on PPC_PSERIES
	help
	  This is the IBM POWER Virtual Management Channel

	  This driver is to be used for the POWER Virtual
	  Management Channel virtual adapter on the PowerVM
	  platform. It provides both request/response and
	  async message support through the /dev/ibmvmc node.

	  To compile this driver as a module, choose M here: the
	  module will be called ibmvmc.

config PHANTOM
	tristate "Sensable PHANToM (PCI)"
	depends on PCI
	help
	  Say Y here if you want to build a driver for Sensable PHANToM device.

	  This driver is only for PCI PHANToMs.

	  If you choose to build module, its name will be phantom. If unsure,
	  say N here.

config RPMB
	tristate "RPMB partition interface"
	depends on MMC
	help
	  Unified RPMB unit interface for RPMB capable devices such as eMMC and
	  UFS. Provides interface for in-kernel security controllers to access
	  RPMB unit.

	  If unsure, select N.

config TIFM_CORE
	tristate "TI Flash Media interface support"
	depends on PCI
	help
	  If you want support for Texas Instruments(R) Flash Media adapters
	  you should select this option and then also choose an appropriate
	  host adapter, such as 'TI Flash Media PCI74xx/PCI76xx host adapter
	  support', if you have a TI PCI74xx compatible card reader, for
	  example.
	  You will also have to select some flash card format drivers. MMC/SD
	  cards are supported via 'MMC/SD Card support: TI Flash Media MMC/SD
	  Interface support (MMC_TIFM_SD)'.

	  To compile this driver as a module, choose M here: the module will
	  be called tifm_core.

config TIFM_7XX1
	tristate "TI Flash Media PCI74xx/PCI76xx host adapter support"
	depends on PCI && TIFM_CORE
	default TIFM_CORE
	help
	  This option enables support for Texas Instruments(R) PCI74xx and
	  PCI76xx families of Flash Media adapters, found in many laptops.
	  To make actual use of the device, you will have to select some
	  flash card format drivers, as outlined in the TIFM_CORE Help.

	  To compile this driver as a module, choose M here: the module will
	  be called tifm_7xx1.

config ICS932S401
	tristate "Integrated Circuits ICS932S401"
	depends on I2C
	help
	  If you say yes here you get support for the Integrated Circuits
	  ICS932S401 clock control chips.

	  This driver can also be built as a module. If so, the module
	  will be called ics932s401.

config ATMEL_SSC
	tristate "Device driver for Atmel SSC peripheral"
	depends on HAS_IOMEM && (ARCH_AT91 || COMPILE_TEST)
	help
	  This option enables device driver support for Atmel Synchronized
	  Serial Communication peripheral (SSC).

	  The SSC peripheral supports a wide variety of serial frame based
	  communications, i.e. I2S, SPI, etc.

	  If unsure, say N.

config ENCLOSURE_SERVICES
	tristate "Enclosure Services"
	help
	  Provides support for intelligent enclosures (bays which
	  contain storage devices).  You also need either a host
	  driver (SCSI/ATA) which supports enclosures
	  or a SCSI enclosure device (SES) to use these services.

config SGI_XP
	tristate "Support communication between SGI SSIs"
	depends on NET
	depends on X86_UV && SMP
	depends on X86_64 || BROKEN
	select SGI_GRU if X86_64 && SMP
	help
	  An SGI machine can be divided into multiple Single System
	  Images which act independently of each other and have
	  hardware based memory protection from the others.  Enabling
	  this feature will allow for direct communication between SSIs
	  based on a network adapter and DMA messaging.

config SMPRO_ERRMON
	tristate "Ampere Computing SMPro error monitor driver"
	depends on MFD_SMPRO || COMPILE_TEST
	help
	  Say Y here to get support for the SMpro error monitor function
	  provided by Ampere Computing's Altra and Altra Max SoCs. Upon
	  loading, the driver creates sysfs files which can be use to gather
	  multiple HW error data reported via read and write system calls.

	  To compile this driver as a module, say M here. The driver will be
	  called smpro-errmon.

config SMPRO_MISC
	tristate "Ampere Computing SMPro miscellaneous driver"
	depends on MFD_SMPRO || COMPILE_TEST
	help
	  Say Y here to get support for the SMpro error miscellalenous function
	  provided by Ampere Computing's Altra and Altra Max SoCs.

	  To compile this driver as a module, say M here. The driver will be
	  called smpro-misc.

config CS5535_MFGPT
	tristate "CS5535/CS5536 Geode Multi-Function General Purpose Timer (MFGPT) support"
	depends on MFD_CS5535
	help
	  This driver provides access to MFGPT functionality for other
	  drivers that need timers.  MFGPTs are available in the CS5535 and
	  CS5536 companion chips that are found in AMD Geode and several
	  other platforms.  They have a better resolution and max interval
	  than the generic PIT, and are suitable for use as high-res timers.
	  You probably don't want to enable this manually; other drivers that
	  make use of it should enable it.

config CS5535_MFGPT_DEFAULT_IRQ
	int
	depends on CS5535_MFGPT
	default 7
	help
	  MFGPTs on the CS5535 require an interrupt.  The selected IRQ
	  can be overridden as a module option as well as by driver that
	  use the cs5535_mfgpt_ API; however, different architectures might
	  want to use a different IRQ by default.  This is here for
	  architectures to set as necessary.

config CS5535_CLOCK_EVENT_SRC
	tristate "CS5535/CS5536 high-res timer (MFGPT) events"
	depends on GENERIC_CLOCKEVENTS && CS5535_MFGPT
	help
	  This driver provides a clock event source based on the MFGPT
	  timer(s) in the CS5535 and CS5536 companion chips.
	  MFGPTs have a better resolution and max interval than the
	  generic PIT, and are suitable for use as high-res timers.

config GEHC_ACHC
	tristate "GEHC ACHC support"
	depends on SPI && SYSFS
	depends on SOC_IMX53 || COMPILE_TEST
	select FW_LOADER
	help
	  Support for GE ACHC microcontroller, that is part of the GE
	  PPD device.

	  To compile this driver as a module, choose M here: the
	  module will be called gehc-achc.

config HI6421V600_IRQ
	tristate "HiSilicon Hi6421v600 IRQ and powerkey"
	depends on OF
	depends on SPMI
	depends on HAS_IOMEM
	select MFD_CORE
	select REGMAP_SPMI
	help
	  This driver provides IRQ handling for Hi6421v600, used on
	  some Kirin chipsets, like the one at Hikey 970.

config HP_ILO
	tristate "Channel interface driver for the HP iLO processor"
	depends on PCI
	help
	  The channel interface driver allows applications to communicate
	  with iLO management processors present on HP ProLiant servers.
	  Upon loading, the driver creates /dev/hpilo/dXccbN files, which
	  can be used to gather data from the management processor, via
	  read and write system calls.

	  To compile this driver as a module, choose M here: the
	  module will be called hpilo.

config QCOM_COINCELL
	tristate "Qualcomm coincell charger support"
	depends on MFD_SPMI_PMIC || COMPILE_TEST
	help
	  This driver supports the coincell block found inside of
	  Qualcomm PMICs.  The coincell charger provides a means to
	  charge a coincell battery or backup capacitor which is used
	  to maintain PMIC register and RTC state in the absence of
	  external power.

config QCOM_FASTRPC
	tristate "Qualcomm FastRPC"
	depends on ARCH_QCOM || COMPILE_TEST
	depends on RPMSG
	select DMA_SHARED_BUFFER
	select QCOM_SCM
	help
	  Provides a communication mechanism that allows for clients to
	  make remote method invocations across processor boundary to
	  applications DSP processor. Say M if you want to enable this
	  module.

config SGI_GRU
	tristate "SGI GRU driver"
	depends on X86_UV && SMP
	select MMU_NOTIFIER
	help
	  The GRU is a hardware resource located in the system chipset. The GRU
	  contains memory that can be mmapped into the user address space.
	  This memory is used to communicate with the GRU to perform functions
	  such as load/store, scatter/gather, bcopy, AMOs, etc.  The GRU is
	  directly accessed by user instructions using user virtual addresses.
	  GRU instructions (ex., bcopy) use user virtual addresses for operands.

	  If you are not running on a SGI UV system, say N.

config SGI_GRU_DEBUG
	bool  "SGI GRU driver debug"
	depends on SGI_GRU
	help
	  This option enables additional debugging code for the SGI GRU driver.
	  If you are unsure, say N.

config APDS9802ALS
	tristate "Medfield Avago APDS9802 ALS Sensor module"
	depends on I2C
	help
	  If you say yes here you get support for the ALS APDS9802 ambient
	  light sensor.

	  This driver can also be built as a module.  If so, the module
	  will be called apds9802als.

config ISL29003
	tristate "Intersil ISL29003 ambient light sensor"
	depends on I2C && SYSFS
	help
	  If you say yes here you get support for the Intersil ISL29003
	  ambient light sensor.

	  This driver can also be built as a module.  If so, the module
	  will be called isl29003.

config ISL29020
	tristate "Intersil ISL29020 ambient light sensor"
	depends on I2C
	help
	  If you say yes here you get support for the Intersil ISL29020
	  ambient light sensor.

	  This driver can also be built as a module.  If so, the module
	  will be called isl29020.

config SENSORS_TSL2550
	tristate "Taos TSL2550 ambient light sensor"
	depends on I2C && SYSFS
	help
	  If you say yes here you get support for the Taos TSL2550
	  ambient light sensor.

	  This driver can also be built as a module.  If so, the module
	  will be called tsl2550.

config SENSORS_BH1770
	 tristate "BH1770GLC / SFH7770 combined ALS - Proximity sensor"
	 depends on I2C
	help
	   Say Y here if you want to build a driver for BH1770GLC (ROHM) or
	   SFH7770 (Osram) combined ambient light and proximity sensor chip.

	   To compile this driver as a module, choose M here: the
	   module will be called bh1770glc. If unsure, say N here.

config SENSORS_APDS990X
	 tristate "APDS990X combined als and proximity sensors"
	 depends on I2C
	help
	   Say Y here if you want to build a driver for Avago APDS990x
	   combined ambient light and proximity sensor chip.

	   To compile this driver as a module, choose M here: the
	   module will be called apds990x. If unsure, say N here.

config HMC6352
	tristate "Honeywell HMC6352 compass"
	depends on I2C
	help
	  This driver provides support for the Honeywell HMC6352 compass,
	  providing configuration and heading data via sysfs.

config DS1682
	tristate "Dallas DS1682 Total Elapsed Time Recorder with Alarm"
	depends on I2C
	help
	  If you say yes here you get support for Dallas Semiconductor
	  DS1682 Total Elapsed Time Recorder.

	  This driver can also be built as a module.  If so, the module
	  will be called ds1682.

config VMWARE_BALLOON
	tristate "VMware Balloon Driver"
	depends on VMWARE_VMCI && X86 && HYPERVISOR_GUEST
	select MEMORY_BALLOON
	help
	  This is VMware physical memory management driver which acts
	  like a "balloon" that can be inflated to reclaim physical pages
	  by reserving them in the guest and invalidating them in the
	  monitor, freeing up the underlying machine pages so they can
	  be allocated to other guests. The balloon can also be deflated
	  to allow the guest to use more physical memory.

	  If unsure, say N.

	  To compile this driver as a module, choose M here: the
	  module will be called vmw_balloon.

config PCH_PHUB
	tristate "Intel EG20T PCH/LAPIS Semicon IOH(ML7213/ML7223/ML7831) PHUB"
	select GENERIC_NET_UTILS
	depends on PCI && (X86_32 || MIPS || COMPILE_TEST)
	help
	  This driver is for PCH(Platform controller Hub) PHUB(Packet Hub) of
	  Intel Topcliff which is an IOH(Input/Output Hub) for x86 embedded
	  processor. The Topcliff has MAC address and Option ROM data in SROM.
	  This driver can access MAC address and Option ROM data in SROM.

	  This driver also can be used for LAPIS Semiconductor's IOH,
	  ML7213/ML7223/ML7831.
	  ML7213 which is for IVI(In-Vehicle Infotainment) use.
	  ML7223 IOH is for MP(Media Phone) use.
	  ML7831 IOH is for general purpose use.
	  ML7213/ML7223/ML7831 is companion chip for Intel Atom E6xx series.
	  ML7213/ML7223/ML7831 is completely compatible for Intel EG20T PCH.

	  To compile this driver as a module, choose M here: the module will
	  be called pch_phub.

config LATTICE_ECP3_CONFIG
	tristate "Lattice ECP3 FPGA bitstream configuration via SPI"
	depends on SPI && SYSFS
	select FW_LOADER
	help
	  This option enables support for bitstream configuration (programming
	  or loading) of the Lattice ECP3 FPGA family via SPI.

	  If unsure, say N.

config SRAM
	bool "Generic on-chip SRAM driver"
	depends on HAS_IOMEM
	select GENERIC_ALLOCATOR
	select SRAM_EXEC if ARM
	help
	  This driver allows you to declare a memory region to be managed by
	  the genalloc API. It is supposed to be used for small on-chip SRAM
	  areas found on many SoCs.

config SRAM_EXEC
	bool

config DW_XDATA_PCIE
	depends on PCI
	tristate "Synopsys DesignWare xData PCIe driver"
	help
	  This driver allows controlling Synopsys DesignWare PCIe traffic
	  generator IP also known as xData, present in Synopsys DesignWare
	  PCIe Endpoint prototype.

	  If unsure, say N.

config PCI_ENDPOINT_TEST
	depends on PCI
	select CRC32
	tristate "PCI Endpoint Test driver"
	help
	   Enable this configuration option to enable the host side test driver
	   for PCI Endpoint.

config XILINX_SDFEC
	tristate "Xilinx SDFEC 16"
	depends on HAS_IOMEM
	help
	  This option enables support for the Xilinx SDFEC (Soft Decision
	  Forward Error Correction) driver. This enables a char driver
	  for the SDFEC.

	  You may select this driver if your design instantiates the
	  SDFEC(16nm) hardened block. To compile this as a module choose M.

	  If unsure, say N.

config MISC_RTSX
	tristate
	default MISC_RTSX_PCI || MISC_RTSX_USB

config HISI_HIKEY_USB
	tristate "USB GPIO Hub on HiSilicon Hikey 960/970 Platform"
	depends on (OF && GPIOLIB) || COMPILE_TEST
	depends on USB_ROLE_SWITCH
	help
	  If you say yes here this adds support for the on-board USB GPIO hub
	  found on HiKey 960/970 boards, which is necessary to support
	  switching between the dual-role USB-C port and the USB-A host ports
	  using only one USB controller.

config OPEN_DICE
	tristate "Open Profile for DICE driver"
	depends on OF_RESERVED_MEM
	depends on HAS_IOMEM
	help
	  This driver exposes a DICE reserved memory region to userspace via
	  a character device. The memory region contains Compound Device
	  Identifiers (CDIs) generated by firmware as an output of DICE
	  measured boot flow. Userspace can use CDIs for remote attestation
	  and sealing.

	  If unsure, say N.

config NTSYNC
	tristate "NT synchronization primitive emulation"
	depends on BROKEN
	help
	  This module provides kernel support for emulation of Windows NT
	  synchronization primitives. It is not a hardware driver.

	  To compile this driver as a module, choose M here: the
	  module will be called ntsync.

	  If unsure, say N.

config VCPU_STALL_DETECTOR
	tristate "Guest vCPU stall detector"
	depends on OF && HAS_IOMEM
	help
	  When this driver is bound inside a KVM guest, it will
	  periodically "pet" an MMIO stall detector device from each vCPU
	  and allow the host to detect vCPU stalls.

	  To compile this driver as a module, choose M here: the module
	  will be called vcpu_stall_detector.

	  If you do not intend to run this kernel as a guest, say N.

config TMR_MANAGER
	tristate "Select TMR Manager"
	depends on MICROBLAZE && MB_MANAGER
	help
	  This option enables the driver developed for TMR Manager.
	  The Triple Modular Redundancy(TMR) manager provides support for
	  fault detection.

	  Say N here unless you know what you are doing.

config TMR_INJECT
	tristate "Select TMR Inject"
	depends on TMR_MANAGER && FAULT_INJECTION_DEBUG_FS
	help
	  This option enables the driver developed for TMR Inject.
	  The Triple Modular Redundancy(TMR) Inject provides
	  fault injection.

	  Say N here unless you know what you are doing.

config TPS6594_ESM
	tristate "TI TPS6594 Error Signal Monitor support"
	depends on MFD_TPS6594
	default MFD_TPS6594
	help
	  Support ESM (Error Signal Monitor) on TPS6594 PMIC devices.
	  ESM is used typically to reboot the board in error condition.

	  This driver can also be built as a module.  If so, the module
	  will be called tps6594-esm.

config TPS6594_PFSM
	tristate "TI TPS6594 Pre-configurable Finite State Machine support"
	depends on MFD_TPS6594
	default MFD_TPS6594
	help
	  Support PFSM (Pre-configurable Finite State Machine) on TPS6594 PMIC devices.
	  These devices integrate a finite state machine engine, which manages the state
	  of the device during operating state transition.

	  This driver can also be built as a module.  If so, the module
	  will be called tps6594-pfsm.

config NSM
	tristate "Nitro (Enclaves) Security Module support"
	depends on VIRTIO
	select HW_RANDOM
	help
	  This driver provides support for the Nitro Security Module
	  in AWS EC2 Nitro based Enclaves. The driver exposes a /dev/nsm
	  device user space can use to communicate with the hypervisor.

	  To compile this driver as a module, choose M here.
	  The module will be called nsm.

config MARVELL_CN10K_DPI
	tristate "Octeon CN10K DPI driver"
	depends on PCI && PCI_IOV
	depends on ARCH_THUNDER || (COMPILE_TEST && 64BIT)
	help
	  Enables Octeon CN10K DMA packet interface (DPI) driver which
	  intializes DPI hardware's physical function (PF) device's
	  global configuration and its virtual function (VFs) resource
	  configuration to enable DMA transfers. DPI PF device does not
	  have any data movement functionality, it only serves VF's
	  resource configuration requests.

	  To compile this driver as a module, choose M here: the module
	  will be called mrvl_cn10k_dpi.

config KK_SENSOR_OKUMA
	bool "Kara Kutu: Kirin 710 read-only sensor log (coul V/I, CPU vote)"
	depends on OF && SPMI && MFD_SYSCON
	help
	  Kara Kutu (G34/G35): logs battery voltage/current (hi6555v200 coul, SPMI reads),
	  the PMCTRL CPU frequency vote, battery temperature (the exact 4.9 HKADC request
	  to LPM3 over IPC mailbox-16/0, at most once per 30 s) and SoC temperatures
	  (the 4.9 SMC 0xc5009900), and reboots to the bootloader when a temperature
	  fuse trips. Never writes PMIC or charger registers.

config KK_I2C6_KAPI
	bool "Kara Kutu: Kirin 710 i2c6 gate (read-only CRG/pinmux check)"
	depends on OF && OF_IRQ && I2C_DESIGNWARE_PLATFORM
	help
	  Kara Kutu (G39): reads (never writes) the IOMCU CRG clock gate/reset
	  status and the pinmux of i2c6; only if the bootloader left them usable
	  is the (DT-disabled) designware i2c6 platform device created.

config KK_HI6523_OKU
	bool "Kara Kutu: hi6523 charger read-only logger"
	depends on I2C && OF
	help
	  Kara Kutu (G39, phase 1): reads selected side-effect-free hi6523
	  registers (as 4.9 does) once at probe, then every 30 s after a 60 s
	  gap. Contains no register write path.

config KK_SARJ_SAHTE
	bool "Kara Kutu: FAKE hi6523 + battery model (QEMU only)"
	depends on OF
	help
	  Kara Kutu (G39): in-memory fake charger chip and battery used to test
	  the charge policy in QEMU. Never touches hardware. Never enable in the
	  device image.

config KK_HI6523_DENEY
	bool "Kara Kutu: phase 2 one-shot CHG_EN experiment (sysfs)"
	depends on KK_HI6523_OKU || KK_SARJ_SAHTE
	help
	  Kara Kutu (G40): manually triggered single CHG_EN=1 experiment with
	  read-back, no watchdog feeding, observed for at least 60 s and ended
	  by the driver itself within 3 min. Adds the only hi6523 write path
	  (register 0x90). Not in the phase 1 device image.

config KK_SARJ_POLITIKA
	bool "Kara Kutu: charge policy state machine"
	depends on KK_SARJ_SAHTE || (KK_HI6523_OKU && KK_SENSOR_OKUMA)
	help
	  Kara Kutu (G39): OCV band charge policy. G42 (phase 3): with the hi6523
	  I2C backend (DT "karakutu,sarj-politika") and the chip watchdog layer:
	  writes only 0x90 (CHG_EN), 0xE9 [1:0] (WDT 40 s) and 0xE8 b0 (feed).

config KK_PIL_KORUMA
	bool "Kara Kutu: low battery protection (G-6)"
	depends on OF && CPU_FREQ && KK_SENSOR_OKUMA
	help
	  Kara Kutu (G54, G-6): reads battery V/I through kk_sensor_pil() (coul,
	  read-only SPMI; QEMU: fake battery) and applies three levels: K1 cpufreq
	  ceiling, K2 lowest OPP (+ uevent), K3 one-shot critical action (log only,
	  reboot to a recovery target, or clean poweroff when VBUS is inferred
	  absent). No hardware writes: the ceiling is a freq_qos request.

config KK_PIL_KORUMA_YALNIZ_LOG
	bool "Kara Kutu: low battery protection LOG ONLY (no actions compiled in)"
	depends on KK_PIL_KORUMA
	help
	  Kara Kutu (G55, Beyin: "yalniz log kipi, eylem yok"): levels are computed
	  and logged only. The cpufreq ceiling (freq_qos), the level uevent and the
	  K3 actions (ksys_sync, kernel_restart, orderly_poweroff,
	  kernel_power_off) are NOT compiled in; DT "karakutu,pil-kritik-eylem" is
	  ignored (always "gunluk").

config KK_SARJ_TEST
	bool "Kara Kutu: charge policy TEST hooks (test image only)"
	depends on KK_SARJ_POLITIKA
	help
	  Kara Kutu (G42): kernel command line overrides kk_sarj.test_alt_mv,
	  test_ust_mv, test_pencere_sn, test_dinlenme_sn and the sysfs hook
	  "test_besleme_kes" (stop feeding the chip watchdog without touching
	  CHG_EN). Never in the production image.

config KK_WIFI_M0
	bool "Kara Kutu: Hi1102/SDIO M0 read-only state dump"
	depends on OF
	help
	  Kara Kutu (G42, Wi-Fi slice 2): reads (never writes) the clock gate,
	  reset, pinmux, GPIO and PMIC 32 kHz state needed to bring up the
	  Hi1102 SDIO Wi-Fi. A block's registers are read only after its gate
	  and reset status show it accessible. Not in device images unless
	  approved.

config KK_SDIO_KAPI
	bool "Kara Kutu: Kirin 710 SDIO (dwmmc2 / Hi1102) M1 gate"
	depends on OF && OF_IRQ && OF_ADDRESS && SPMI && MFD_KK_SPMI_SYSCON && MMC_DW_K3
	help
	  Kara Kutu (G45, Wi-Fi M1; G47 S3): off unless the kernel command
	  line has kk_sdio_kapi.ac=1 (then no MMIO/SPMI access at all). When
	  on, probe only READS CRG/pinmux/GPIO/PMIC state and checks
	  preconditions (no write at boot). The write sequence runs only when
	  root writes 1 to the device's sysfs file "baslat" (accepted once per
	  boot; a second trigger is refused): conditional, read-back-verified
	  PMIC 0x3E (see KK_SDIO_KAPI_PMIC_YAZ), CRG (CLKDIV19 b6, PEREN0 b21,
	  PEREN4 b19, PERRSTDIS4 b20), GPIO3_6 (masked DATA) and iomg-mmc1
	  pinmux writes, then the DT-disabled dwmmc2 device is created and the
	  SDIO card enumeration result is logged (no SDIO function driver may
	  be built in). Stops on any unexpected value without MMIO rollback.

config KK_SDIO_KAPI_PMIC_YAZ
	bool "Kara Kutu: SDIO gate may write PMIC 0x3E b0 (approval W1 ONLY)"
	depends on KK_SDIO_KAPI
	help
	  Kara Kutu (G45/G46/G47 W1): compiles the single PMIC write site
	  (0x3E 0x00 -> 0x01, en_32k_bt; only if that write's own read-back
	  does not match, a single rollback 0x3E <- 0x00 from the same site;
	  a stop in a later step leaves 0x3E = 0x01) into kk-sdio-kapi; it is
	  used only with the additional command line flag
	  kk_sdio_kapi.pmic_yaz=1 (default 0) and only after the sysfs
	  trigger. Without the flag, or without this option, the gate only
	  reads 0x3E and stops unless it is already 0x01. W1 approved (G47);
	  default n, only the Faz B image variant enables it.

config KK_HI1102_YUKLE
	bool "Kara Kutu: Hi1102 ROM firmware loader (Wi-Fi M2; sysfs trigger only)"
	depends on KK_SDIO_KAPI
	select CRC32
	select CRYPTO_LIB_SHA256 if !KK_HI1102_YALNIZ_KIP1
	help
	  Kara Kutu (G48, Wi-Fi M2a): minimal loader that talks to the Hi1102
	  boot ROM over the SDIO function the kk-sdio-kapi card check found.
	  Off unless the command line has kk_hi1102_yukle.ac=1; then only two
	  sysfs files appear next to kk-sdio-kapi (no SDIO access at boot, no
	  SDIO function driver is registered). Writing 1 to "yukle" runs the
	  handshake (efuse EC READM + VERSION); writing 2 runs the full download
	  (needs kk_hi1102_yukle.kip_azami=2 and real firmware). Once per boot.
	  All card writes go through one gate limited to a compile time list;
	  the command table is generated at build time from the 4.9 config.
	  G50 (M2c): with the download path built, the embedded images are
	  checked at run time by length, CRC32 and SHA-256 (lib/crypto) before
	  any SDIO access; only the 261632 byte chunk size is accepted.

config KK_HI1102_YALNIZ_KIP1
	bool "Kara Kutu: Hi1102 loader, handshake only (M2b; no download code, no firmware)"
	depends on KK_HI1102_YUKLE
	help
	  Kara Kutu (G49, Wi-Fi M2b): builds only mode 1 of kk-hi1102-yukle
	  (enable fn1, block 512, interrupt mask, F0 0xF0 <- 0, READM efuse EC
	  and VERSION). The download path (SETPM/WRITEM/FILES/QUIT, ready poll),
	  the embedded firmware images and the full command table are NOT
	  compiled; the gate's table has only the READM and VERSION texts.
	  Writing 2 to "yukle" returns -EPERM.

config KK_HI1102_FW_DIR
	string "Directory with the Hi1102 images to embed (cr4_asic.bin, CPU_RAM_SCHED.bin, CPU_RAM_WBS.bin, kk-hi1102-fw-ozet.h)"
	depends on KK_HI1102_YUKLE && !KK_HI1102_YALNIZ_KIP1
	default ""

config KK_HI1102_M3B
	bool "Kara Kutu: Hi1102 M3b (port host layers on top of M3a: cfg80211 STA, passive scan only)"
	depends on KK_SDIO_KAPI && MMC && CFG80211=y && !WILC1000_SDIO && !CFG80211_WEXT && !CFG80211_REQUIRE_SIGNED_REGDB
	select RTC_LIB
	help
	  Kara Kutu (G55, Wi-Fi M3b): after the M3a loader (P-D A0-A9 + A10
	  hcc_enable) reports WLAN_READY, the Huawei host layers (oal/hcc/frw/
	  oam + wal/hmac, built in, no module) take over the bound fn1 with a
	  polled receive, register a wiphy (station only) and wlan0. Single
	  power-up (no GPIO, no mmc_hw_reset, no file firmware), compile-time
	  HCC transmit whitelist (anything else stops), passive scan only
	  (no probe request, connect, mgmt tx, AP, P2P). Requires
	  KK_HI1102_PORT and KK_HI1102_M3A (#error otherwise).

config KK_HI1102_M3C
	bool "Kara Kutu: Hi1102 M3c (connect to one AP: open/WPA2-PSK, passive scan only)"
	depends on KK_HI1102_M3B
	help
	  Kara Kutu (G57 M3c, Beyin framework G57): registers cfg80211
	  connect/disconnect/add_key/del_key/set_default_key on top of M3b,
	  opens the data path behind an L3 whitelist (EAPOL, ARP, DHCP client,
	  ICMP echo on-link), widens the HCC transmit whitelist to the M3c list
	  (anything else -> RED + DUR), pads CONNECT_REQ / STA_SET_EDCA_REG to
	  the 4.9 wire layout, never arms the 120 s STA power-save timer, keeps
	  netdev MAC and MIB StationID identical and masks MAC bytes in OAM logs.

config KK_HI1102_M3C_MAC
	string "Kara Kutu: Hi1102 M3c wlan0 MAC (12 hex, NVE #193 MACWLAN replacement)"
	depends on KK_HI1102_M3C
	default ""
	help
	  Default of hi1102_plat.kk_wlan_mac. Empty: random xx:11:02:.. (4.9
	  error path). The same value is used for wlan0 and the MIB
	  StationID (802.11 addr2).

config KK_HI1102_M3C_QEMU
	bool "Kara Kutu: Hi1102 M3c QEMU-only helpers (record mode, x20 timeouts, fake AP)"
	depends on KK_HI1102_M3C && KK_HI1102_YUKLE_SAHTE
	help
	  Kara Kutu (G56/G57): measurement helpers for the fake Hi1102 only.
	  Record mode (kk_m3c_kayit=1 lets non-listed frames through and logs
	  them), auth/assoc timeouts x20 and the fake AP (auth/assoc, DHCP,
	  ARP, ICMP, WPA2-PSK 4-way handshake). Depends on the fake ROM model,
	  so it can never be enabled in a device image.

config KK_HI1102_M3C_L3_GENIS
	bool "Kara Kutu: Hi1102 M3c wider L3 whitelist (IPv4 unicast TCP/UDP/ICMP), off unless kk_m3c_l3_genis=1"
	depends on KK_HI1102_M3C
	help
	  Kara Kutu (G59-C, Brain approval item): compiles an extension of the
	  M3c data-path L3 whitelist. With boot parameter kk_m3c_l3_genis=1 the
	  filter additionally passes IPv4 unicast TCP, UDP and any ICMP type
	  whose source is wlan0's own address and whose destination is not
	  multicast, broadcast, zero-net or loopback. The default (parameter
	  absent or 0) is the unchanged M3c behaviour: EAPOL, ARP, DHCP client
	  and on-link ICMP echo only. The HCC transmit gate shares the same
	  function, so the last line of defence widens identically.

config KK_HI6523_O1
	bool "Kara Kutu: hi6523 reader also reads STATUS0 (0x06) and 0x8E"
	depends on KK_HI6523_OKU
	help
	  Kara Kutu (G44, approval O1): adds the read-only STATUS0 (ACL/DPM/
	  thermal regulation) and OTG_RESERVE2 (5V VDPM selection) registers
	  to the hi6523 reader list. Both are read by 4.9 in normal operation.

config KK_GUC_TESHIS
	bool "Kara Kutu: read-only power state diagnosis dump"
	depends on OF
	help
	  Kara Kutu (G44): reads (never writes) clock gate, reset and power
	  domain status registers to show which blocks the bootloader left
	  on. A block's own registers are read only after its gate, reset
	  and power status show it accessible. Dumps at probe and once more
	  after a delay. Not in device images unless approved.

config KK_RESET_NEDENI
	bool "Kara Kutu: read-only previous reset reason log (PMIC 0x1E1, SCTRL SCSYSSTAT)"
	depends on OF && SPMI && MFD_SYSCON
	help
	  Kara Kutu (G47, KV7): reads once at boot, never writes, the PMIC
	  HRST_REG13 reboot reason (0x1E1, through the kk-spmi-syscon regmap)
	  and SCTRL SCSYSSTAT (0x004, through the SCTRL syscon regmap), and logs
	  them. Writing SCSYSSTAT resets the SoC; this driver has no write path.

config KK_I2C3_KAPI
	bool "Kara Kutu: Kirin 710 i2c3 gate (G1-G4 read; session-triggered open)"
	depends on OF && OF_IRQ && I2C_DESIGNWARE_PLATFORM
	help
	  Kara Kutu (G47 S1, G48 P1): reads the PERI CRG i2c3 clock gate/reset
	  status, pinmux and pinconf. If all are as expected the (DT-disabled)
	  designware i2c3 device is created at boot without any write.
	  Otherwise nothing is written at boot; writing "ac" to sysfs "kapi"
	  (user space, kk-idle-bekci A0) opens only i2c3's own clock/reset/pinmux
	  bits (4-entry compiled whitelist, each at most once, read back).

config KK_LM36274_KK
	bool "Kara Kutu: LM36274 backlight reader + brightness-0 trigger (production)"
	depends on I2C && OF
	help
	  Kara Kutu (G48 P1, production): reads LM36274 (address 0x11 only)
	  registers at probe without writing; the fault flag register 0x0F is
	  never read. sysfs "kk_arka_isik" accepts only "kapat": 0x04 <- 0 and
	  0x05 <- 0 (compiled whitelist {0x04<-0, 0x05<-0}), each read back.
	  There is no restore path; reboot restores the bootloader value.

config KK_S1_SAHTE
	bool "Kara Kutu: S1 FAKE i2c3/LM36274 adapter and fake bases (QEMU only)"
	depends on I2C && OF
	help
	  Kara Kutu (G47 S1): in-memory fake i2c3 bus with a fake LM36274 at
	  0x11, and acceptance of QEMU RAM addresses in the i2c3 gate. Never
	  enable in a device image.

source "drivers/misc/c2port/Kconfig"
source "drivers/misc/eeprom/Kconfig"
source "drivers/misc/cb710/Kconfig"
source "drivers/misc/ti-st/Kconfig"
source "drivers/misc/lis3lv02d/Kconfig"
source "drivers/misc/altera-stapl/Kconfig"
source "drivers/misc/mei/Kconfig"
source "drivers/misc/vmw_vmci/Kconfig"
source "drivers/misc/genwqe/Kconfig"
source "drivers/misc/echo/Kconfig"
source "drivers/misc/cxl/Kconfig"
source "drivers/misc/ocxl/Kconfig"
source "drivers/misc/bcm-vk/Kconfig"
source "drivers/misc/cardreader/Kconfig"
source "drivers/misc/uacce/Kconfig"
source "drivers/misc/pvpanic/Kconfig"
source "drivers/misc/mchp_pci1xxxx/Kconfig"
source "drivers/misc/keba/Kconfig"
endmenu
```
